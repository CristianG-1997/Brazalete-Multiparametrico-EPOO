#include "BluetoothSerial.h"
#if !defined(CONFIG_BT_ENABLED) || !defined(CONFIG_BLUEDROID_ENABLED)
#error Bluetooth is not enabled! Please run `make menuconfig` to and enable it
#endif

#include <Wire.h>
//#include "MAX30100_PulseOximeter.h"
#include <Adafruit_MPU6050.h>
#include <Adafruit_Sensor.h>
#include "MAX30100.h"

#include "Adafruit_GFX.h"
#include "OakOLED.h"

OakOLED oled;
#define REPORTING_PERIOD_MS 80
Adafruit_MPU6050 mpu;
float Ts = 1000;
int Seleccion=0;
MAX30100 sensor;
unsigned long timer = 0;
long loopTime = 10000;   // microseconds


// pines electrodo
const int Electrodo1 = 34;
const int Electrodo2 = 35;
const int Electrodo3 = 36;
const int Electrodo4 = 37;
int ElE1Value = 0;
int ElE2Value = 0;
int ElE3Value = 0;
int ElE4Value = 0;
 

BluetoothSerial SerialBT;

unsigned int samples = 0;
unsigned long start, finish;
const int NumSamples = 10; // Cada cuanto se va imprimir en la lcd y muestras que va tomar 20->2s
float SamplesHR[NumSamples];
float SumHR = 0.0;
float last = 0.0;
int SumSpO2 = 0.0;
int LevelO[NumSamples];
float HeartRate = 0.0;
int SpO2 = 0;
boolean Flag = false;
//PulseOximeter pox;

unsigned long tsLastReport = 0;


const unsigned char bitmap [] PROGMEM=
{
0x00, 0x00, 0x00, 0x00, 0x01, 0x80, 0x18, 0x00, 0x0f, 0xe0, 0x7f, 0x00, 0x3f, 0xf9, 0xff, 0xc0,
0x7f, 0xf9, 0xff, 0xc0, 0x7f, 0xff, 0xff, 0xe0, 0x7f, 0xff, 0xff, 0xe0, 0xff, 0xff, 0xff, 0xf0,
0xff, 0xf7, 0xff, 0xf0, 0xff, 0xe7, 0xff, 0xf0, 0xff, 0xe7, 0xff, 0xf0, 0x7f, 0xdb, 0xff, 0xe0,
0x7f, 0x9b, 0xff, 0xe0, 0x00, 0x3b, 0xc0, 0x00, 0x3f, 0xf9, 0x9f, 0xc0, 0x3f, 0xfd, 0xbf, 0xc0,
0x1f, 0xfd, 0xbf, 0x80, 0x0f, 0xfd, 0x7f, 0x00, 0x07, 0xfe, 0x7e, 0x00, 0x03, 0xfe, 0xfc, 0x00,
0x01, 0xff, 0xf8, 0x00, 0x00, 0xff, 0xf0, 0x00, 0x00, 0x7f, 0xe0, 0x00, 0x00, 0x3f, 0xc0, 0x00,
0x00, 0x0f, 0x00, 0x00, 0x00, 0x06, 0x00, 0x00, 0x00, 0x00, 0x00, 0x00, 0x00, 0x00, 0x00, 0x00
};

const unsigned char Teste [] PROGMEM = {
0xff, 0xff, 0xff, 0xff, 0xff, 0xff, 0xff, 0xff, 0xff, 0xff, 0xff, 0xff, 0xff, 0xff, 0xff, 0xff, 
  0xff, 0xff, 0xff, 0xff, 0xff, 0xff, 0xff, 0xff, 0xff, 0xff, 0xff, 0xff, 0xff, 0xff, 0xff, 0xff, 
  0xff, 0xff, 0xff, 0xff, 0xff, 0xff, 0xff, 0xff, 0xff, 0xff, 0xff, 0xff, 0xff, 0xff, 0xff, 0xff, 
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  0xff, 0xff, 0xff, 0xff, 0xc0, 0x00, 0x00, 0x00, 0x00, 0x00, 0x00, 0x07, 0xff, 0xff, 0xff, 0xff
};




void setup(void) {
  Serial.begin(115200);

oled.begin();
oled.clearDisplay();
oled.setTextSize(1);
oled.setTextColor(1);
  
SerialBT.begin("ESP32test"); //Bluetooth device name
  timer = micros();
 Serial.print("Initializing MAX30100..");

    if (!sensor.begin()) {
        Serial.print("FAILED: ");

        uint8_t partId = sensor.getPartId();
        if (partId == 0xff) {
            Serial.println("I2C error");
        } else {
            Serial.print("wrong part ID 0x");
            Serial.print(partId, HEX);
            Serial.print(" (expected: 0x");
            Serial.println(EXPECTED_PART_ID, HEX);
        }
        // Stop here
        for(;;);
    } else {
        Serial.println("Success");
    }

    Serial.print("Enabling HR/SPO2 mode..");
    sensor.setMode(MAX30100_MODE_SPO2_HR);
    Serial.println("done.");

    Serial.print("Configuring LEDs biases to 50mA..");
    sensor.setLedsCurrent(MAX30100_LED_CURR_50MA, MAX30100_LED_CURR_50MA);
    Serial.println("done.");

    delay(1000);

    Serial.print("Lowering the current to 7.6mA..");
    sensor.setLedsCurrent(MAX30100_LED_CURR_7_6MA, MAX30100_LED_CURR_7_6MA);
    Serial.println("done.");

    delay(1000);

    Serial.print("Shutting down..");
    sensor.shutdown();
    Serial.println("done.");

    delay(1000);

    Serial.print("Resuming normal operation..");
    sensor.resume();
    delay(500);
    Serial.println("done.");

    uint32_t tsTempSampStart = millis();
    Serial.print("Sampling die temperature..");
    sensor.startTemperatureSampling();
    while(!sensor.isTemperatureReady()) {
        if (millis() - tsTempSampStart > 1000) {
            Serial.println("ERROR: timeout");
            // Stop here
            for(;;);
        }
    }

    float temperature = sensor.retrieveTemperature();
    Serial.print("done, temp=");
    Serial.print(temperature);
    Serial.println("C");

    if (temperature < 5) {
        Serial.println("WARNING: Temperature probe reported an odd value");
    } else {
        Serial.println("All test pass.");
    }
    sensor.resetFifo();




  while (!Serial)
    delay(10); // will pause Zero, Leonardo, etc until serial console opens

  Serial.println("Adafruit MPU6050 test!");

  // Try to initialize!
  if (!mpu.begin()) {
    Serial.println("Failed to find MPU6050 chip");
  }
  
  Serial.println("MPU6050 Found!");

  mpu.setAccelerometerRange(MPU6050_RANGE_8_G);
  Serial.print("Accelerometer range set to: ");
  switch (mpu.getAccelerometerRange()) {
    case MPU6050_RANGE_2_G:
      Serial.println("+-2G");
      break;
    case MPU6050_RANGE_4_G:
      Serial.println("+-4G");
      break;
    case MPU6050_RANGE_8_G:
      Serial.println("+-8G");
      break;
    case MPU6050_RANGE_16_G:
      Serial.println("+-16G");
      break;
  }
  mpu.setGyroRange(MPU6050_RANGE_500_DEG);
  Serial.print("Gyro range set to: ");
  switch (mpu.getGyroRange()) {
    case MPU6050_RANGE_250_DEG:
      Serial.println("+- 250 deg/s");
      break;
    case MPU6050_RANGE_500_DEG:
      Serial.println("+- 500 deg/s");
      break;
    case MPU6050_RANGE_1000_DEG:
      Serial.println("+- 1000 deg/s");
      break;
    case MPU6050_RANGE_2000_DEG:
      Serial.println("+- 2000 deg/s");
      break;
  }

  mpu.setFilterBandwidth(MPU6050_BAND_5_HZ);
  Serial.print("Filter bandwidth set to: ");
  switch (mpu.getFilterBandwidth()) {
    case MPU6050_BAND_260_HZ:
      Serial.println("260 Hz");
      break;
    case MPU6050_BAND_184_HZ:
      Serial.println("184 Hz");
      break;
    case MPU6050_BAND_94_HZ:
      Serial.println("94 Hz");
      break;
    case MPU6050_BAND_44_HZ:
      Serial.println("44 Hz");
      break;
    case MPU6050_BAND_21_HZ:
      Serial.println("21 Hz");
      break;
    case MPU6050_BAND_10_HZ:
      Serial.println("10 Hz");
      break;
    case MPU6050_BAND_5_HZ:
      Serial.println("5 Hz");
      break;
  }


  
  oled.drawBitmap( 60, 20, bitmap, 28, 28, 1);
  oled.display();
}



void loop() {


   uint16_t ir, red;
 int IR,RED;
    sensor.update();
   // if (millis() - tsLastReport > REPORTING_PERIOD_MS) {

    if(!sensor.getRawValues(&ir, &red))
    {
      sensor.resetFifo();
      }
   
   // Serial.println( sensor.getRawValues(&ir, &red));
    IR=(int)ir/10;
    RED=(int)red/10;
   
  
if (SerialBT.available())
{
 Seleccion = SerialBT.readString().toInt();
}

if(Seleccion==1)
{ oled.clearDisplay();
  oled.drawBitmap(0, 0, Teste, 128, 64, 1);
 oled.display();
  Acelerometro();
  oled.clearDisplay();
   oled.display();
}

 oled.clearDisplay();
  
if(Seleccion==2)
{
 
 int m;
 sendToPC2(&IR, &RED);

        Serial.println(RED);
 
 
}

if(Seleccion!=1 || Seleccion!=2 || Seleccion!=3)
{
   oled.clearDisplay();
    oled.display();

  oled.drawBitmap( 60, 20, bitmap, 28, 28, 1);
  oled.display();
  
}
 
if(Seleccion==3)
{
  oled.clearDisplay(); 
  oled.drawBitmap(0, 0, Teste, 128, 64, 1);
 oled.display();
Electrodos();
Seleccion=0;
   oled.clearDisplay();
    oled.display();
}



   Serial.println(Seleccion);

   SerialBT.flush();
    
}


 
void timeSync(unsigned long deltaT)
{
  unsigned long currTime = micros();
  long timeToDelay = deltaT - (currTime - timer);
  if (timeToDelay > 10000)
  {
    delay(timeToDelay / 1000);
    delayMicroseconds(timeToDelay % 1000);
  }
  else if (timeToDelay > 0)
  {
    delayMicroseconds(timeToDelay);
  }
  else
  {
    // timeToDelay is negative so we start immediately
  }
  timer = currTime + timeToDelay;
}

void sendToPC(int* data1, int* data2, int* data3)
{
  byte* byteData1 = (byte*)(data1);
  byte* byteData2 = (byte*)(data2);
  byte* byteData3 = (byte*)(data3);

  byte buf[12] = {byteData1[0], byteData1[1], byteData1[2], byteData1[3],
                 byteData2[0], byteData2[1], byteData2[2], byteData2[3],
                 byteData3[0], byteData3[1], byteData3[2], byteData3[3]};
  SerialBT.write(buf, 12);

}


void sendToPCe(int* data1, int* data2, int* data3,int* data4)
{
  byte* byteData1 = (byte*)(data1);
  byte* byteData2 = (byte*)(data2);
  byte* byteData3 = (byte*)(data3);
  byte* byteData4 = (byte*)(data4);

  byte buf[16] = {byteData1[0], byteData1[1], byteData1[2], byteData1[3],
                 byteData2[0], byteData2[1], byteData2[2], byteData2[3],
                 byteData3[0], byteData3[1], byteData3[2], byteData3[3],
                 byteData4[0], byteData4[1], byteData4[2], byteData4[3]};
  SerialBT.write(buf, 16);

}

void sendToPC2(int* data1, int* data2)
{
  byte* byteData1 = (byte*)(data1);
  byte* byteData2 = (byte*)(data2);


  byte buf[8] = {byteData1[0], byteData1[1], byteData1[2], byteData1[3],
                 byteData2[0], byteData2[1], byteData2[2], byteData2[3]};
  SerialBT.write(buf, 8);

}
void Acelerometro()
{
  while (1)
  {
    if (SerialBT.available())
    {
     Seleccion = SerialBT.readString().toInt();
     Seleccion=0;
     oled.clearDisplay();
     break;
    }

  timeSync(loopTime);
  sensors_event_t a, g, temp;
  mpu.getEvent(&a, &g, &temp);

  int x = (int) a.acceleration.x;
  int y = (int) a.acceleration.y;
  int z = (int) a.acceleration.z;
  sendToPC(&x, &y, &z);
  }
}





void Electrodos()
{
  while (1)
  {
    if (SerialBT.available())
    {
     Seleccion = SerialBT.readString().toInt();
       oled.clearDisplay();
     break;
    }

  ElE1Value = analogRead(Electrodo1)*0.48;
  ElE2Value = analogRead(Electrodo2)*0.48;
  ElE3Value = analogRead(Electrodo3)*0.48;
  ElE4Value = analogRead(Electrodo4)*0.48;
     
  sendToPCe(&ElE1Value, &ElE2Value, &ElE3Value,&ElE4Value);
  }
}

void startMAX()
{


}

  
