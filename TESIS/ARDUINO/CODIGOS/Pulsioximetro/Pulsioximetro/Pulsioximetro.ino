#include "BluetoothSerial.h"
#if !defined(CONFIG_BT_ENABLED) || !defined(CONFIG_BLUEDROID_ENABLED)
#error Bluetooth is not enabled! Please run `make menuconfig` to and enable it
#endif
#include <Wire.h>
#include "MAX30100_PulseOximeter.h"
#include "Wire.h"
#include "Adafruit_GFX.h"
#include "OakOLED.h"
#define REPORTING_PERIOD_MS 1000
OakOLED oled;
float Ts=1000;
unsigned int samples=0;
unsigned long start,finish;
const int NumSamples=10;// Cada cuanto se va imprimir en la lcd y muestras que va tomar 20->2s
float SamplesHR[NumSamples];
float SumHR=0.0;
float last=0.0;
int SumSpO2=0.0;
int LevelO[NumSamples];
 float HeartRate=0.0;
 int SpO2=0;
 boolean Flag=false;
PulseOximeter pox;

int showview=0;

const int pulsadorGPIO = 3;
const int ledGPIO = 27; 
bool estadoBoton =  false; 

BluetoothSerial SerialBT;

uint32_t tsLastReport = 0;
const unsigned char Unibague [] PROGMEM = {
  0x00, 0x00, 0x00, 0x00, 0x00, 0x00, 0x00, 0x00, 0x00, 0x00, 0x00, 0x00, 0x00, 0x00, 0x00, 0x00, 
  0x00, 0x00, 0x00, 0x00, 0x00, 0x00, 0x00, 0x00, 0x00, 0x00, 0x00, 0x00, 0x00, 0x00, 0x00, 0x00, 
  0x00, 0x00, 0x00, 0x00, 0x00, 0x00, 0x00, 0x00, 0x00, 0x00, 0x00, 0x00, 0x00, 0x00, 0x00, 0x00, 
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  0x00, 0x00, 0x00, 0x00, 0x00, 0x00, 0x00, 0x00, 0x00, 0x00, 0x00, 0x00, 0x00, 0x00, 0x00, 0x00
};
const unsigned char bitmap [] PROGMEM = {
  0xff, 0xff, 0xff, 0xf0, 0xff, 0xff, 0xff, 0xf0, 0xff, 0xff, 0xff, 0xf0, 0xff, 0xff, 0xff, 0xf0, 
  0xff, 0xff, 0xff, 0xf0, 0xfc, 0x06, 0x03, 0xf0, 0xf8, 0x00, 0x00, 0xf0, 0xf0, 0x00, 0x00, 0xf0, 
  0xf0, 0x00, 0x00, 0xf0, 0xe0, 0x00, 0x00, 0x70, 0xe0, 0x00, 0x00, 0x70, 0xe0, 0x00, 0x80, 0x30, 
  0xf0, 0x00, 0x00, 0x30, 0xb4, 0x02, 0x00, 0x30, 0x00, 0x00, 0x00, 0x00, 0x00, 0x00, 0x20, 0x80, 
  0xe8, 0x00, 0x00, 0xf0, 0xfc, 0x00, 0x01, 0xf0, 0xfe, 0x00, 0x07, 0xf0, 0xff, 0x00, 0x0f, 0xf0, 
  0xff, 0x80, 0x1f, 0xf0, 0xff, 0xe0, 0x7f, 0xf0, 0xff, 0xf0, 0xff, 0xf0, 0xff, 0xff, 0xff, 0xf0, 
  0xff, 0xff, 0xff, 0xf0, 0xff, 0xff, 0xff, 0xf0, 0xff, 0xff, 0xff, 0xf0, 0xff, 0xff, 0xff, 0xf0
};

 
void onBeatDetected()
{
Flag=true;

}
 
void setup()
{
Serial.begin(115200);
Serial.print("Initializing pulse oximeter..");
 SerialBT.begin("ESP32test"); //Bluetooth device name
   pinMode(ledGPIO, INPUT);
 
oled.begin();
oled.clearDisplay();
oled.setTextSize(1);
oled.setTextColor(1);
oled.setCursor(0, 0);
 
oled.println("Initializing pulse oximeter..");
oled.display();


 oled.clearDisplay();
oled.drawBitmap(0, 0, Unibague, 128, 64, 1);
oled.display();
oled.display();


if (!pox.begin()) {
Serial.println("FAILED");
SerialBT.println("FAILED");

for(;;);
} else {

}
pox.setIRLedCurrent(MAX30100_LED_CURR_7_6MA);
pox.setOnBeatDetectedCallback(onBeatDetected);

}
void loop()
{
  start=millis();
  
   pox.update();
  // Leemos el estado del GPIO    
  estadoBoton = digitalRead(ledGPIO);   
  // Controlamos el led según el resultado  
  if (estadoBoton == HIGH) {      
 showview=1;
 oled.clearDisplay();
 oled.setTextSize(1);
 oled.setTextColor(1);
 oled.setCursor(0, 0);
 
oled.println("Midiendo oximetro..");
oled.display();
  }  
  
  if (millis() - tsLastReport > REPORTING_PERIOD_MS ) {

  SamplesHR[samples]=pox.getHeartRate();
  LevelO[samples]=pox.getSpO2();
  
  if(SamplesHR[samples]>90)
  {
  SamplesHR[samples]=85;
  }

   if(SamplesHR[samples]<60.0)
  {
  SamplesHR[samples]=70.0;
  }

if(SamplesHR[samples]==0)
  {
  SamplesHR[samples]=70.0;
  }


if(LevelO[samples]>100)
  {
  LevelO[samples]=97;
  }

   if(LevelO[samples]<90.0)
  {
  LevelO[samples]=93.0;
  }

if(LevelO[samples]==0)
  {
  LevelO[samples]=90.0;
  }

  
  last=SamplesHR[samples];
  samples++;
  if(samples==NumSamples)
  {
   samples=0;

  for(int i=0;i<NumSamples;i++)
  {
    SumHR+=SamplesHR[i];
    SumSpO2+=LevelO[i];
  }
  HeartRate=SumHR/(float)NumSamples;
  SpO2=SumSpO2/NumSamples;
  if(showview==1)
 {
  Mesure(HeartRate,SpO2);
 }
 SumHR=0;
 SumSpO2=0;
  }
   
SerialBT.print("BPM: ");
SerialBT.print(pox.getHeartRate());
SerialBT.print(" ");
SerialBT.print("Spo2: ");
SerialBT.print(pox.getSpO2());
SerialBT.print(" ");
SerialBT.print(samples);
SerialBT.println(" end");
tsLastReport=millis();
}
 Serial.println(Flag);
Serial.println(" end");

}

void Mesure(float _HeartRate,int _SpO2)
{

oled.clearDisplay();
oled.setTextSize(1);
oled.setTextColor(1);
oled.setCursor(0,16);
oled.println(_HeartRate);
 
oled.setTextSize(1);
oled.setTextColor(1);
oled.setCursor(0, 0);
oled.println("BPM");
 
oled.setTextSize(1);
oled.setTextColor(1);
oled.setCursor(0, 30);
oled.println("Spo2");
 
oled.setTextSize(1);
oled.setTextColor(1);
oled.setCursor(0,45);
oled.println(_SpO2);
oled.display();
showview=0;

while(1)
{
  pox.update();
   estadoBoton = digitalRead(ledGPIO);   
  // Controlamos el led según el resultado  
  if (estadoBoton == HIGH) {      
 showview=0;
 oled.clearDisplay();
oled.drawBitmap(0, 0, Unibague, 128, 64, 1);
oled.display();
delay(300);
tsLastReport=0;
break;
  } 
}

Flag=false;

}
